## drivers/char/scull/Kconfig
```kconfig
# SPDX-License-Identifier: GPL-2.0
menu "Scull"

config SCULL
	bool "Scull Drivers"
	help
	  Enable support for scull drivers

if SCULL

config SCULL_DRIVER
	bool "Scull Driver"
	depends on MMU
	default n
	help
	  Scull is an example in Linux Device Driver 3.

config SCULL_DRIVER_RUST
	bool "Scull Driver in Rust"
	depends on MMU && RUST
	default n
	help
	  Implementation of scull in Rust.

endif # if SCULL

endmenu
```
